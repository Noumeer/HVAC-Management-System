## main/Kconfig.projbuild
```kconfig
menu "Example Configuration"

    choice EXAMPLE_PROV_TRANSPORT
        bool "Provisioning Transport"
        default EXAMPLE_PROV_TRANSPORT_SOFTAP if IDF_TARGET_ESP32S2
        default EXAMPLE_PROV_TRANSPORT_BLE
        help
            Wi-Fi provisioning component offers both, SoftAP and BLE transports. Choose any one.

        config EXAMPLE_PROV_TRANSPORT_BLE
            bool "BLE"
            select BT_ENABLED
            depends on !IDF_TARGET_ESP32S2
        config EXAMPLE_PROV_TRANSPORT_SOFTAP
            bool "Soft AP"
    endchoice

    config EXAMPLE_PROV_TRANSPORT
        int
        default 1 if EXAMPLE_PROV_TRANSPORT_BLE
        default 2 if EXAMPLE_PROV_TRANSPORT_SOFTAP

    config EXAMPLE_RESET_PROVISIONED
        bool
        default n
        prompt "Reset provisioned status of the device"
        help
            This erases the NVS to reset provisioned status of the device on every reboot.
            Provisioned status is determined by the Wi-Fi STA configuration, saved on the NVS.

    config EXAMPLE_RESET_PROV_MGR_ON_FAILURE
        bool
        default y
        prompt "Reset provisioned credentials and state machine after session failure"
        help
            Enable reseting provisioned credentials and state machine after session failure.
            This will restart the provisioning service after retries are exhausted.

    config EXAMPLE_PROV_MGR_MAX_RETRY_CNT
        int
        default 5
        prompt "Max retries before reseting provisioning state machine"
        depends on EXAMPLE_RESET_PROV_MGR_ON_FAILURE
        help
            Set the Maximum retry to avoid reconnecting to an inexistent AP or if credentials
            are misconfigured. Provisioned credentials are erased and internal state machine
            is reset after this threshold is reached.

    config EXAMPLE_PROV_SHOW_QR
        bool "Show provisioning QR code"
        default y
        help
            Show the QR code for provisioning.

    config EXAMPLE_PROV_USING_BLUEDROID
        bool
        depends on (BT_BLUEDROID_ENABLED && (IDF_TARGET_ESP32C3 || IDF_TARGET_ESP32S3))
        select BT_BLE_42_FEATURES_SUPPORTED
        default y
        help
            This enables BLE 4.2 features for Bluedroid.
    config IOTHUB_CONNECTION_STRING
    string "IOT Hub Device Connection String"
	default ""
	help
		String containing Hostname, Device Id & Device Key in the format:
		HostName=<host_name>;DeviceId=<device_id>;SharedAccessKey=<device_key>
		You can get this from the Azure IoT CLI or the Azure Portal.

config MESSAGE_INTERVAL_TIME
    int "Time delay in Milliseconds between two consecutive messages"
    default 100
    help
        Set time delay between two consecutive message sent to the cloud

config MESSAGE_COUNT
    int "Total number of messages to be sent to the cloud"
    default 50
    help
        This example will terminate after sending these many
        messages. If the message count is set as 0 then this example
        will send indefinite messages to the cloud.
config IOTHUB_CONNECTION_STRING
    string "IOT Hub Device Connection String"
	default ""
	help
		String containing Hostname, Device Id & Device Key in the format:
		HostName=<host_name>;DeviceId=<device_id>;SharedAccessKey=<device_key>
		You can get this from the Azure IoT CLI or the Azure Portal.

config MESSAGE_INTERVAL_TIME
    int "Time delay in Milliseconds between two consecutive messages"
    default 100
    help
        Set time delay between two consecutive message sent to the cloud

config MESSAGE_COUNT
    int "Total number of messages to be sent to the cloud"
    default 50
    help
        This example will terminate after sending these many
        messages. If the message count is set as 0 then this example
        will send indefinite messages to the cloud.


config IOTHUB_CONNECTION_STRING
    string "IOT Hub Device Connection String"
    default ""
    help
        String containing Hostname, Device Id & Device Key in the format:
        HostName=<host_name>;DeviceId=<device_id>;SharedAccessKey=<device_key>
        You can get this from the Azure IoT CLI or the Azure Portal.
        
config MESSAGE_INTERVAL_TIME
    int "Time delay in Milliseconds between two consecutive messages"
    default 100
    help
        Set time delay between two consecutive message sent to the cloud
        
config MESSAGE_COUNT
    int "Total number of messages to be sent to the cloud"
    default 50
    help
        This example will terminate after sending these many
        messages. If the message count is set as 0 then this example
        will send indefinite messages to the cloud.
        
endmenu
```
